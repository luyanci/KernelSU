## kernel/Kconfig
```kconfig
menu "KernelSU"

config KSU
	tristate "KernelSU function support"
	default y
	help
	  Enable kernel-level root privileges on Android System.
	  To compile as a module, choose M here: the
	  module will be called kernelsu.

config KSU_DEBUG
	bool "KernelSU debug mode"
	depends on KSU
	default n
	help
	  Enable KernelSU debug mode.

config KSU_ALLOWLIST_WORKAROUND
	bool "KernelSU Session init keyring workaround"
	depends on KSU
	default n
	help
	  Enable session keyring init workaround for problematic devices.
	  Useful for situations where the SU allowlist is not kept after a reboot.

config KSU_CMDLINE
	bool "Enable KernelSU cmdline"
	depends on KSU && KSU != m
	default n
	help
	  Enable a cmdline called kernelsu.enabled
	  Value 1 means enabled, value 0 means disabled.

choice
    prompt "KernelSU hook type"
    depends on KSU
    default KSU_KPROBES_HOOK
    help
      Hook type for KernelSU

config KSU_KPROBES_HOOK
    bool "Hook KernelSU with Kprobes"
	depends on KPROBES
	help
	  If enabled, Hook required KernelSU syscalls with Kernel-probe.

config KSU_MANUAL_HOOK
	bool "Manual hooking GKI kernels without kprobes"
	depends on KSU && KSU != m
	help
	  If enabled, Hook required KernelSU syscalls with manually-patched function.

config KSU_TRACEPOINT_HOOK
    bool "Hook KernelSU with Tracepoint"
	depends on TRACEPOINTS
	help
	  If enabled, Hook required KernelSU syscalls with Tracepoint.

endchoice

endmenu
```
